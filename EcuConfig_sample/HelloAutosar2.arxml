AUTOSAR XML (schema 4-0-3)
package /Ecuc
  module config Os: ecuc-def-edition=4.2.0, implementation-config-variant=VARIANT-PRE-COMPILE
    MainApp (OsAppMode)
    OsOS: OsStackMonitoring=true, OsStatus=EXTENDED, OsUseGetServiceId=true, OsUseParameterAccess=true, OsScalabilityClass=SC1
      OsHooks: OsErrorHook=true, OsProtectionHook=true, OsPreTaskHook=false, OsPostTaskHook=false, OsStartupHook=false, OsShutdownHook=false
      OsHookStack: OsHookStackSize=1024
      OsOsStack: OsOsStackSize=4096
    4 x OsTask, all with OsTaskActivation=1, OsTaskSchedule=FULL, OsTaskStackSize=1024:
      TASK1: OsTaskPriority=10
      TASK2: OsTaskPriority=10
      TASKBG: OsTaskPriority=5
      ECU_INIT_TASK: OsTaskPriority=15
        OsTaskAutostart: OsTaskAppModeRef=MainApp
    3 x OsAlarm, all with OsAlarmCounterRef=MAIN_HW_COUNTER:
      ALARM1
        OsAlarmAction
          OsAlarmActivateTask: OsAlarmActivateTaskRef=TASK1
        OsAlarmAutostart: OsAlarmAlarmTime=6000000, OsAlarmCycleTime=600000, OsAlarmAutostartType=RELATIVE, OsAlarmAppModeRef=MainApp
      ALARM2
        OsAlarmAction
          OsAlarmActivateTask: OsAlarmActivateTaskRef=TASK2
        OsAlarmAutostart: OsAlarmAlarmTime=6000000, OsAlarmCycleTime=600000, OsAlarmAutostartType=RELATIVE, OsAlarmAppModeRef=MainApp
      ALARMBG
        OsAlarmAction
          OsAlarmActivateTask: OsAlarmActivateTaskRef=TASKBG
        OsAlarmAutostart: OsAlarmAlarmTime=6000000, OsAlarmCycleTime=600000, OsAlarmAutostartType=RELATIVE, OsAlarmAppModeRef=MainApp
  module config EcuC: ecuc-def-edition=4.2.0, implementation-config-variant=VARIANT-PRE-COMPILE
    EcucPduCollection: PduIdTypeEnum=UINT16, PduLengthTypeEnum=UINT16
      Pdu1 (Pdu): PduLength=4
  module config Rte: ecuc-def-edition=4.2.0, implementation-config-variant=VARIANT-PRE-COMPILE
    RteBswGeneral: RteSchMVersionInfoApi=false, RteUseComShadowSignalApi=false
    RteGeneration:
      RteCalibrationSupport = NONE
      RteCodeVendorId = 65
      RteDevErrorDetect = true
      RteDevErrorDetectUninit = true
      RteGenerationMode = COMPATIBILITY_MODE
      RteMeasurementSupport = false
      RteOptimizationMode = MEMORY
      RteValueRangeCheckEnabled = false
      RteVfbTraceEnabled = false
    RteInitializationBehavior: RteInitializationStrategy=RTE_INITIALIZATION_STRATEGY_AT_RTE_START, RteSectionInitializationPolicy=CLEARED
    SWCI1 (RteSwComponentInstance): RteSoftwareComponentInstanceRef=SWC1
      TimingEvent1 (RteEventToTaskMapping): RteImmediateRestart=false, RtePositionInTask=1, RteActivationOffset=0.5, RteEventRef=TimingEvent, RteMappedToTaskRef=TASK1, RteUsedOsAlarmRef=ALARM1
      BackGroundEvent1 (RteEventToTaskMapping): RteImmediateRestart=false, RtePositionInTask=1, RteEventRef=BackgroundEvent, RteMappedToTaskRef=TASKBG, RteUsedOsAlarmRef=ALARMBG
    SWCI2 (RteSwComponentInstance): RteSoftwareComponentInstanceRef=SWC2
      TimingEvent2 (RteEventToTaskMapping): RteImmediateRestart=false, RtePositionInTask=1, RteActivationOffset=1, RteEventRef=TimingEvent, RteMappedToTaskRef=TASK2, RteUsedOsAlarmRef=ALARM2
      BackGroundEvent2 (RteEventToTaskMapping): RteImmediateRestart=false, RtePositionInTask=2, RteEventRef=BackgroundEvent, RteMappedToTaskRef=TASKBG, RteUsedOsAlarmRef=ALARMBG
    RteOsInteraction
      3 x RteUsedOsActivation, all with RteExpectedActivationOffset=0.1, RteExpectedTickDuration=0.01:
        RteUsedOsActivation1: RteActivationOsAlarmRef=ALARM1
        RteUsedOsActivation2: RteActivationOsAlarmRef=ALARM2
        RteUsedOsActivationBG: RteActivationOsAlarmRef=ALARMBG
