AUTOSAR XML (schema 4-0-3)
package /Ecuc
  module config Os: ecuc-def-edition=4.2.0, implementation-config-variant=VARIANT-PRE-COMPILE
    MainApp (OsAppMode)
    OsOS: OsStackMonitoring=true, OsStatus=EXTENDED, OsUseGetServiceId=true, OsUseParameterAccess=true, OsScalabilityClass=SC1
      OsHooks: OsStartupHook=false, OsErrorHook=true, OsProtectionHook=true, OsPostTaskHook=false, OsPreTaskHook=false, OsShutdownHook=false
      OsHookStack: OsHookStackSize=1024
      OsOsStack: OsOsStackSize=4096
    TASK1 (OsTask): OsTaskActivation=1, OsTaskPriority=10, OsTaskSchedule=FULL, OsTaskStackSize=1024
    ECU_INIT_TASK (OsTask): OsTaskActivation=1, OsTaskPriority=15, OsTaskSchedule=FULL, OsTaskStackSize=1024
      OsTaskAutostart: OsTaskAppModeRef=MainApp
    ALARM1 (OsAlarm): OsAlarmCounterRef=MAIN_HW_COUNTER
      OsAlarmAction
        OsAlarmActivateTask: OsAlarmActivateTaskRef=TASK1
      OsAlarmAutostart: OsAlarmAlarmTime=6000000, OsAlarmCycleTime=600000, OsAlarmAutostartType=RELATIVE, OsAlarmAppModeRef=MainApp
  module config Rte: ecuc-def-edition=4.2.0, implementation-config-variant=VARIANT-PRE-COMPILE
    RteBswGeneral: RteSchMVersionInfoApi=false, RteUseComShadowSignalApi=false
    RteGeneration:
      RteCalibrationSupport = NONE
      RteCodeVendorId = 65
      RteDevErrorDetect = true
      RteDevErrorDetectUninit = true
      RteGenerationMode = COMPATIBILITY_MODE
      RteMeasurementSupport = false
      RteOptimizationMode = MEMORY
      RteValueRangeCheckEnabled = false
      RteVfbTraceEnabled = false
    RteInitializationBehavior: RteInitializationStrategy=RTE_INITIALIZATION_STRATEGY_AT_RTE_START, RteSectionInitializationPolicy=CLEARED
    5 x RteSwComponentInstance:
      CddBrake: RteSoftwareComponentInstanceRef=CddBrake
        TimingEventCB (RteEventToTaskMapping): RteImmediateRestart=false, RtePositionInTask=0, RteEventRef=TimingEventCB, RteMappedToTaskRef=TASK1, RteUsedOsAlarmRef=ALARM1
      CddAccelerator: RteSoftwareComponentInstanceRef=CddAccelerator
        TimingEventCA (RteEventToTaskMapping): RteImmediateRestart=false, RtePositionInTask=1, RteEventRef=TimingEventCA, RteMappedToTaskRef=TASK1, RteUsedOsAlarmRef=ALARM1
      EngineController: RteSoftwareComponentInstanceRef=EngineController
        TimingEventEC (RteEventToTaskMapping): RteImmediateRestart=false, RtePositionInTask=2, RteEventRef=TimingEventEC, RteMappedToTaskRef=TASK1, RteUsedOsAlarmRef=ALARM1
      CddAccelLevelLed: RteSoftwareComponentInstanceRef=CddAccelLevelLed
        TimingEventCALL (RteEventToTaskMapping): RteImmediateRestart=false, RtePositionInTask=3, RteEventRef=TimingEventCALL, RteMappedToTaskRef=TASK1, RteUsedOsAlarmRef=ALARM1
      CddSpeedoMeter: RteSoftwareComponentInstanceRef=CddSpeedoMeter
        TimingEventCSM (RteEventToTaskMapping): RteImmediateRestart=false, RtePositionInTask=4, RteEventRef=TimingEventCSM, RteMappedToTaskRef=TASK1, RteUsedOsAlarmRef=ALARM1
    RteOsInteraction
      RteUsedOsActivation: RteExpectedTickDuration=0.01, RteExpectedActivationOffset=0, RteActivationOsAlarmRef=ALARM1
