AUTOSAR XML (schema 4-0-3)
package /Ecuc
  module config Os: ecuc-def-edition=4.2.0, implementation-config-variant=VARIANT-PRE-COMPILE
    MainApp (OsAppMode)
    OsOS: OsStackMonitoring=true, OsStatus=EXTENDED, OsUseGetServiceId=true, OsUseParameterAccess=true, OsScalabilityClass=SC1
      OsHooks: OsStartupHook=false, OsErrorHook=true, OsProtectionHook=true, OsPostTaskHook=false, OsPreTaskHook=false, OsShutdownHook=false
      OsHookStack: OsHookStackSize=1024
      OsOsStack: OsOsStackSize=4096
    TASK1 (OsTask): OsTaskActivation=1, OsTaskPriority=10, OsTaskSchedule=FULL, OsTaskStackSize=1024
    ECU_INIT_TASK (OsTask): OsTaskActivation=1, OsTaskPriority=15, OsTaskSchedule=FULL, OsTaskStackSize=1024
      OsTaskAutostart: OsTaskAppModeRef=MainApp
    ALARM1 (OsAlarm): OsAlarmCounterRef=MAIN_HW_COUNTER
      OsAlarmAction
        OsAlarmActivateTask: OsAlarmActivateTaskRef=TASK1
      OsAlarmAutostart: OsAlarmAlarmTime=6000000, OsAlarmCycleTime=600000, OsAlarmAutostartType=RELATIVE, OsAlarmAppModeRef=MainApp
  module config Rte: ecuc-def-edition=4.2.0, implementation-config-variant=VARIANT-PRE-COMPILE
    RteBswGeneral: RteSchMVersionInfoApi=false, RteUseComShadowSignalApi=false
    RteGeneration:
      RteCalibrationSupport = NONE
      RteCodeVendorId = 65
      RteDevErrorDetect = true
      RteDevErrorDetectUninit = true
      RteGenerationMode = COMPATIBILITY_MODE
      RteMeasurementSupport = false
      RteOptimizationMode = MEMORY
      RteValueRangeCheckEnabled = false
      RteVfbTraceEnabled = false
    RteInitializationBehavior: RteInitializationStrategy=RTE_INITIALIZATION_STRATEGY_AT_RTE_START, RteSectionInitializationPolicy=CLEARED
    5 x RteSwComponentInstance:
      SWCI_AutoWiperController: RteSoftwareComponentInstanceRef=AutoWiperController
        RteEventToTaskMapping: RteImmediateRestart=false, RtePositionInTask=1, RteEventRef=TimingEvent, RteMappedToTaskRef=TASK1, RteUsedOsAlarmRef=ALARM1
      SWCI_CddDisplayRain: RteSoftwareComponentInstanceRef=CddDisplayRain
        RteEventToTaskMapping: RteImmediateRestart=false, RtePositionInTask=2, RteEventRef=TimingEvent, RteMappedToTaskRef=TASK1, RteUsedOsAlarmRef=ALARM1
      SWCI_CddWiperActuator: RteSoftwareComponentInstanceRef=CddWiperActuator
        RteEventToTaskMapping: RteImmediateRestart=false, RtePositionInTask=3, RteEventRef=TimingEvent, RteMappedToTaskRef=TASK1, RteUsedOsAlarmRef=ALARM1
      SWCI_CddRainSensor: RteSoftwareComponentInstanceRef=CddRainSensor
        OperationInvokedEvent (RteEventToTaskMapping): RteImmediateRestart=false, RteEventRef=OperationInvokedEvent
      SWCI_CddWiperSwitch: RteSoftwareComponentInstanceRef=CddWiperSwitch
        OperationInvokedEvent (RteEventToTaskMapping): RteImmediateRestart=false, RteEventRef=OperationInvokedEvent
    RteOsInteraction
      RteUsedOsActivation: RteExpectedTickDuration=0.01, RteExpectedActivationOffset=0, RteActivationOsAlarmRef=ALARM1
