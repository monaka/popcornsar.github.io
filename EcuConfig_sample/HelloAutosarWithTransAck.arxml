AUTOSAR XML (schema 4-0-3)
package /Ecuc
  module config Os: ecuc-def-edition=4.2.0, implementation-config-variant=VARIANT-PRE-COMPILE
    MainApp (OsAppMode)
    OsOS: OsStackMonitoring=true, OsStatus=EXTENDED, OsUseGetServiceId=true, OsUseParameterAccess=true, OsScalabilityClass=SC1
      OsHooks: OsErrorHook=true, OsProtectionHook=true, OsPreTaskHook=false, OsPostTaskHook=false, OsStartupHook=false, OsShutdownHook=false
      OsHookStack: OsHookStackSize=1024
      OsOsStack: OsOsStackSize=4096
    6 x OsTask, all with OsTaskActivation=1, OsTaskSchedule=FULL, OsTaskStackSize=1024:
      TASK1: OsTaskPriority=10
      TASK1DSC1: OsTaskPriority=10
      TASK2: OsTaskPriority=10
      TASK2DR1: OsTaskPriority=10
      TASK2DRE1: OsTaskPriority=10
      ECU_INIT_TASK: OsTaskPriority=15
        OsTaskAutostart: OsTaskAppModeRef=MainApp
    ALARM1 (OsAlarm): OsAlarmCounterRef=MAIN_HW_COUNTER
      OsAlarmAction
        OsAlarmActivateTask: OsAlarmActivateTaskRef=TASK1
      OsAlarmAutostart: OsAlarmAlarmTime=6000000, OsAlarmCycleTime=600000, OsAlarmAutostartType=RELATIVE, OsAlarmAppModeRef=MainApp
    ALARM2 (OsAlarm): OsAlarmCounterRef=MAIN_HW_COUNTER
      OsAlarmAction
        OsAlarmActivateTask: OsAlarmActivateTaskRef=TASK2
      OsAlarmAutostart: OsAlarmAlarmTime=6000000, OsAlarmCycleTime=600000, OsAlarmAutostartType=RELATIVE, OsAlarmAppModeRef=MainApp
  module config EcuC: ecuc-def-edition=4.2.0, implementation-config-variant=VARIANT-PRE-COMPILE
    EcucPduCollection: PduIdTypeEnum=UINT16, PduLengthTypeEnum=UINT16
      Pdu1 (Pdu): PduLength=4
  module config Rte: ecuc-def-edition=4.2.0, implementation-config-variant=VARIANT-PRE-COMPILE
    RteBswGeneral: RteSchMVersionInfoApi=false, RteUseComShadowSignalApi=false
    RteGeneration:
      RteCalibrationSupport = NONE
      RteCodeVendorId = 65
      RteDevErrorDetect = true
      RteDevErrorDetectUninit = true
      RteGenerationMode = COMPATIBILITY_MODE
      RteMeasurementSupport = false
      RteOptimizationMode = MEMORY
      RteValueRangeCheckEnabled = false
      RteVfbTraceEnabled = false
    RteInitializationBehavior: RteInitializationStrategy=RTE_INITIALIZATION_STRATEGY_AT_RTE_START, RteSectionInitializationPolicy=CLEARED
    SWCI1 (RteSwComponentInstance): RteSoftwareComponentInstanceRef=SWC1
      TimingEvent1 (RteEventToTaskMapping): RteImmediateRestart=false, RtePositionInTask=1, RteActivationOffset=0.5, RteEventRef=TimingEvent, RteMappedToTaskRef=TASK1, RteUsedOsAlarmRef=ALARM1
      DataSendCompletedEvent1 (RteEventToTaskMapping): RteImmediateRestart=false, RtePositionInTask=2, RteEventRef=DataSendCompletedEvent1, RteMappedToTaskRef=TASK1DSC1
    SWCI2 (RteSwComponentInstance): RteSoftwareComponentInstanceRef=SWC2
      3 x RteEventToTaskMapping, all with RteImmediateRestart=false:
        TimingEvent2: RtePositionInTask=1, RteActivationOffset=1, RteEventRef=TimingEvent, RteMappedToTaskRef=TASK2, RteUsedOsAlarmRef=ALARM2
        DataReceivedEvent: RtePositionInTask=2, RteEventRef=DataReceivedEvent1, RteMappedToTaskRef=TASK2DR1
        DataReceivedErrorEvent: RtePositionInTask=3, RteEventRef=DataReceiveErrorEvent1, RteMappedToTaskRef=TASK2DRE1
    RteOsInteraction
      RteUsedOsActivation1 (RteUsedOsActivation): RteExpectedActivationOffset=0.1, RteExpectedTickDuration=0.01, RteActivationOsAlarmRef=ALARM1
      RteUsedOsActivation2 (RteUsedOsActivation): RteExpectedActivationOffset=0.1, RteExpectedTickDuration=0.01, RteActivationOsAlarmRef=ALARM2
